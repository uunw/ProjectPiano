#include "tft_gfx.h"
#include "tft_driver.h"
#include <stdio.h>

extern SPI_HandleTypeDef hspi1;

// Font 5x7 
const uint8_t font5x7[] = {
    0x00, 0x00, 0x00, 0x00, 0x00, // (space)
    0x00, 0x00, 0x5F, 0x00, 0x00, // !
    0x00, 0x07, 0x00, 0x07, 0x00, // "
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    0x61, 0x51, 0x49, 0x45, 0x43  // Z
};

void GFX_SetWindow(uint16_t x0, uint16_t y0, uint16_t x1, uint16_t y1) {
    TFT_WriteCommand(0x2A);
    TFT_WriteData(x0 >> 8); TFT_WriteData(x0 & 0xFF);
    TFT_WriteData(x1 >> 8); TFT_WriteData(x1 & 0xFF);

    TFT_WriteCommand(0x2B);
    TFT_WriteData(y0 >> 8); TFT_WriteData(y0 & 0xFF);
    TFT_WriteData(y1 >> 8); TFT_WriteData(y1 & 0xFF);

    TFT_WriteCommand(0x2C);
}

void GFX_FillRect(uint16_t x, uint16_t y, uint16_t w, uint16_t h, uint16_t color) {
    if (x >= TFT_WIDTH || y >= TFT_HEIGHT) return;
    if ((x + w) > TFT_WIDTH) w = TFT_WIDTH - x;
    if ((y + h) > TFT_HEIGHT) h = TFT_HEIGHT - y;
    GFX_SetWindow(x, y, x + w - 1, y + h - 1);
    
    CS_LOW(); DC_HIGH();
    uint32_t count = (uint32_t)w * h;
    uint8_t hi = color >> 8;
    uint8_t lo = color & 0xFF;
    
    while(count--) {
        FastSPI_SendByte(hi);
        FastSPI_SendByte(lo);
    }
    while (SPI1->SR & SPI_SR_BSY); // Important: Wait for last byte to clear
    CS_HIGH();
}

void GFX_DrawRect(uint16_t x, uint16_t y, uint16_t w, uint16_t h, uint16_t color) {
    GFX_FillRect(x, y, w, 1, color);
    GFX_FillRect(x, y + h - 1, w, 1, color);
    GFX_FillRect(x, y, 1, h, color);
    GFX_FillRect(x + w - 1, y, 1, h, color);
}

void GFX_DrawChar(uint16_t x, uint16_t y, char c, uint16_t color, uint16_t bg, uint8_t size) {
    if (c < 32 || c > 90) return;
    uint8_t idx = c - 32;
    for (int8_t i = 0; i < 5; i++) {
        uint8_t line = font5x7[idx * 5 + i];
        for (int8_t j = 0; j < 8; j++) {
            if (line & 0x1) {
                if (size == 1) GFX_FillRect(x + i, y + j, 1, 1, color);
                else GFX_FillRect(x + i * size, y + j * size, size, size, color);
            } else if (bg != color) {
                if (size == 1) GFX_FillRect(x + i, y + j, 1, 1, bg);
                else GFX_FillRect(x + i * size, y + j * size, size, size, bg);
            }
            line >>= 1;
        }
    }
}

void GFX_DrawString(uint16_t x, uint16_t y, const char* str, uint16_t color, uint16_t bg, uint8_t size) {
    while (*str) {
        GFX_DrawChar(x, y, *str++, color, bg, size);
        x += 6 * size;
    }
}

const char* GFX_NoteToName(int note) {
    if (note < 0) return "---";
    static const char* names[] = {"C ", "C#", "D ", "D#", "E ", "F ", "F#", "G ", "G#", "A ", "A#", "B "};
    static char buf[16];
    int octave = (note / 12) - 1;
    int name_idx = note % 12;
    sprintf(buf, "%s%d", names[name_idx], octave);
    return buf;
}
